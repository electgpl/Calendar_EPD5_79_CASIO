/******************************************************************************
 *  Calendar EPD 5.79" - Estilo CASIO Digital Diary
 *  ESP32-S3 + panel 792x272 (dos SSD1683 en cascada, buffer logico 800x272)
 *  Autor: ELECTGPL
 *  Control: Mantener presionado "EXIT" por 3s para entrar en WiFi Manager
 ******************************************************************************/

#include <Arduino.h>
#include <WiFi.h>
#include <WiFiManager.h>
#include <NTPClient.h>
#include <WiFiUdp.h>
#include <time.h>
#include <string.h>

/*===========================================================================
 *  SECCION 1 - CAPA SPI POR SOFTWARE  (ex spi.h / spi.cpp)
 *=========================================================================*/
#define SCK  12
#define MOSI 11
#define RES  47
#define DC   46
#define CS   45
#define BUSY 48

#define EPD_SCK_Clr()  digitalWrite(SCK, LOW)
#define EPD_SCK_Set()  digitalWrite(SCK, HIGH)
#define EPD_MOSI_Clr() digitalWrite(MOSI, LOW)
#define EPD_MOSI_Set() digitalWrite(MOSI, HIGH)
#define EPD_RES_Clr()  digitalWrite(RES, LOW)
#define EPD_RES_Set()  digitalWrite(RES, HIGH)
#define EPD_DC_Clr()   digitalWrite(DC, LOW)
#define EPD_DC_Set()   digitalWrite(DC, HIGH)
#define EPD_CS_Clr()   digitalWrite(CS, LOW)
#define EPD_CS_Set()   digitalWrite(CS, HIGH)
#define EPD_ReadBUSY   digitalRead(BUSY)

void EPD_GPIOInit(void) {
  pinMode(SCK, OUTPUT);
  pinMode(MOSI, OUTPUT);
  pinMode(RES, OUTPUT);
  pinMode(DC, OUTPUT);
  pinMode(CS, OUTPUT);
  pinMode(BUSY, INPUT);
}

// SPI por bit-banging: un byte, MSB primero
void EPD_WR_Bus(uint8_t dat) {
  EPD_CS_Clr();
  for (uint8_t i = 0; i < 8; i++) {
    EPD_SCK_Clr();
    if (dat & 0x80) EPD_MOSI_Set();
    else            EPD_MOSI_Clr();
    EPD_SCK_Set();
    dat <<= 1;
  }
  EPD_CS_Set();
}

void EPD_WR_REG(uint8_t reg) {
  EPD_DC_Clr();
  EPD_WR_Bus(reg);
  EPD_DC_Set();
}

void EPD_WR_DATA8(uint8_t dat) {
  EPD_DC_Set();
  EPD_WR_Bus(dat);
  EPD_DC_Set();
}

/*===========================================================================
 *  SECCION 2 - DEFINICIONES DEL PANEL  (ex EPD_Init.h)
 *
 *  El panel de 5.79" lleva DOS controladores SSD1683 en cascada. Cada uno
 *  maneja 396x272, pero se direccionan como 400x300, por lo que en la union
 *  de ambos quedan 8 columnas muertas. Por eso el buffer se define como
 *  800x272 aunque el area visible real sea 792x272, y Paint_SetPixel()
 *  aplica un desplazamiento de 8 px para Xpoint >= 396.
 *=========================================================================*/
#define EPD_W 800
#define EPD_H 272

#define WHITE 0xFF
#define BLACK 0x00

#define Source_BYTES    (400/8)
#define Gate_BITS       272
#define ALLSCREEN_BYTES (Source_BYTES*Gate_BITS)

// Orientacion del panel: 0 / 90 / 180 / 270
#define Rotation 180

typedef struct {
  uint8_t *Image;
  uint16_t width;
  uint16_t height;
  uint16_t widthMemory;
  uint16_t heightMemory;
  uint16_t color;
  uint16_t rotate;
  uint16_t widthByte;
  uint16_t heightByte;
} PAINT;

PAINT Paint;

/*===========================================================================
 *  SECCION 3 - TABLAS DE FUENTE  (ex EPDfont.h, podado)
 *  Formato: matriz de puntos en franjas verticales de 8 filas, LSB arriba.
 *  Rango ASCII 0x20..0x7E (95 caracteres imprimibles).
 *=========================================================================*/
const unsigned char ascii_1206[95][12]={
{0x00,0x00,0x00,0x00,0x00,0x00,0x00,0x00,0x00,0x00,0x00,0x00},/*" ",0*/
{0x00,0x00,0xFC,0x00,0x00,0x00,0x00,0x00,0x02,0x00,0x00,0x00},/*"!",1*/
{0x00,0x0C,0x02,0x0C,0x02,0x00,0x00,0x00,0x00,0x00,0x00,0x00},/*""",2*/
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{0x02,0x01,0x02,0x04,0x04,0x02,0x00,0x00,0x00,0x00,0x00,0x00},/*"~",94*/
};  

const unsigned char ascii_1608[][16]={	  

{0x00,0x00,0x00,0x00,0x00,0x00,0x00,0x00,0x00,0x00,0x00,0x00,0x00,0x00,0x00,0x00},/*" ",0*/
{0x00,0x00,0x00,0xF8,0x00,0x00,0x00,0x00,0x00,0x00,0x00,0x33,0x00,0x00,0x00,0x00},/*"!",1*/
{0x00,0x10,0x0C,0x02,0x10,0x0C,0x02,0x00,0x00,0x00,0x00,0x00,0x00,0x00,0x00,0x00},/*""",2*/
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{0x00,0x02,0x01,0x02,0x02,0x04,0x02,0x00,0x00,0x00,0x00,0x00,0x00,0x00,0x00,0x00},/*"~",94*/

};  

const unsigned char ascii_2412[][36]={	  
{0x00,0x00,0x00,0x00,0x00,0x00,0x00,0x00,0x00,0x00,0x00,0x00,0x00,0x00,0x00,0x00,0x00,0x00,0x00,0x00,0x00,0x00,0x00,0x00,0x00,0x00,0x00,0x00,0x00,0x00,0x00,0x00,0x00,0x00,0x00,0x00},/*" ",0*/
{0x00,0x00,0x00,0x00,0x00,0xF0,0xF0,0xF0,0x00,0x00,0x00,0x00,0x00,0x00,0x00,0x00,0x00,0x01,0x7F,0x01,0x00,0x00,0x00,0x00,0x00,0x00,0x00,0x00,0x00,0x1C,0x1C,0x1C,0x00,0x00,0x00,0x00},/*"!",1*/
{0x00,0x00,0x80,0x60,0x30,0x1C,0x8C,0x60,0x30,0x1C,0x0C,0x00,0x00,0x00,0x00,0x00,0x00,0x00,0x00,0x00,0x00,0x00,0x00,0x00,0x00,0x00,0x00,0x00,0x00,0x00,0x00,0x00,0x00,0x00,0x00,0x00},/*""",2*/
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{0x00,0x18,0x06,0x02,0x02,0x04,0x08,0x10,0x20,0x20,0x30,0x08,0x00,0x00,0x00,0x00,0x00,0x00,0x00,0x00,0x00,0x00,0x00,0x00,0x00,0x00,0x00,0x00,0x00,0x00,0x00,0x00,0x00,0x00,0x00,0x00},/*"~",94*/



};

/*===========================================================================
 *  SECCION 4 - SECUENCIAS DEL CONTROLADOR  (ex EPD_Init.cpp)
 *=========================================================================*/

// Espera activa a que el panel libere la linea BUSY
void EPD_READBUSY(void) {
  while (1) {
    if (EPD_ReadBUSY == 0) break;
  }
}

void EPD_HW_RESET(void) {
  delay(10);
  EPD_RES_Clr();
  delay(10);
  EPD_RES_Set();
  delay(10);
  EPD_READBUSY();
}

// Refresco COMPLETO: mas lento (~2 s) pero limpia el ghosting
void EPD_Update(void) {
  EPD_WR_REG(0x22);
  EPD_WR_DATA8(0xF7);
  EPD_WR_REG(0x20);
  EPD_READBUSY();
}

// Refresco PARCIAL: mas rapido, puede dejar remanencia si se abusa
void EPD_PartUpdate(void) {
  EPD_WR_REG(0x22);
  EPD_WR_DATA8(0xDC);
  EPD_WR_REG(0x20);
  EPD_READBUSY();
}

// Init en modo rapido: carga el valor de temperatura del sensor interno,
// del que depende la forma de onda de refresco del SSD1683
void EPD_FastMode1Init(void) {
  EPD_HW_RESET();
  EPD_READBUSY();
  EPD_WR_REG(0x12);           // SWRESET
  EPD_READBUSY();

  EPD_WR_REG(0x18);           // sensor de temperatura interno
  EPD_WR_DATA8(0x80);

  EPD_WR_REG(0x22);           // cargar valor de temperatura
  EPD_WR_DATA8(0xB1);
  EPD_WR_REG(0x20);
  EPD_READBUSY();

  EPD_WR_REG(0x1A);           // escribir registro de temperatura
  EPD_WR_DATA8(0x64);
  EPD_WR_DATA8(0x00);

  EPD_WR_REG(0x22);
  EPD_WR_DATA8(0x91);
  EPD_WR_REG(0x20);
  EPD_READBUSY();

  EPD_WR_REG(0x3C);
  EPD_WR_DATA8(0x3);
  EPD_READBUSY();
}

// --- Ventanas de RAM: MP/MA = controlador maestro, SP/SA = esclavo ---
void EPD_SetRAMMP(void) {
  EPD_WR_REG(0x11);           // Data Entry mode: Y decrece, X crece
  EPD_WR_DATA8(0x05);
  EPD_WR_REG(0x44);           // ventana X
  EPD_WR_DATA8(0x00);
  EPD_WR_DATA8(0x31);         // 400/8-1
  EPD_WR_REG(0x45);           // ventana Y
  EPD_WR_DATA8(0x0f);
  EPD_WR_DATA8(0x01);
  EPD_WR_DATA8(0x00);
  EPD_WR_DATA8(0x00);
}

void EPD_SetRAMMA(void) {
  EPD_WR_REG(0x4e);
  EPD_WR_DATA8(0x00);
  EPD_WR_REG(0x4f);
  EPD_WR_DATA8(0x0f);
  EPD_WR_DATA8(0x01);
}

void EPD_SetRAMSP(void) {
  EPD_WR_REG(0x91);
  EPD_WR_DATA8(0x04);
  EPD_WR_REG(0xc4);
  EPD_WR_DATA8(0x31);
  EPD_WR_DATA8(0x00);
  EPD_WR_REG(0xc5);
  EPD_WR_DATA8(0x0f);
  EPD_WR_DATA8(0x01);
  EPD_WR_DATA8(0x00);
  EPD_WR_DATA8(0x00);
}

void EPD_SetRAMSA(void) {
  EPD_WR_REG(0xce);
  EPD_WR_DATA8(0x31);
  EPD_WR_REG(0xcf);
  EPD_WR_DATA8(0x0f);
  EPD_WR_DATA8(0x01);
}

// Limpia la RAM de comparacion (registros 0x26 / 0xA6) de ambos chips
void EPD_Clear_R26A6H(void) {
  uint16_t i, j;
  EPD_SetRAMMA();
  EPD_WR_REG(0x26);
  for (i = 0; i < Gate_BITS; i++)
    for (j = 0; j < Source_BYTES; j++) EPD_WR_DATA8(0xFF);

  EPD_SetRAMSA();
  EPD_WR_REG(0xA6);
  for (i = 0; i < Gate_BITS; i++)
    for (j = 0; j < Source_BYTES; j++) EPD_WR_DATA8(0xFF);
}

void EPD_Display_Clear(void) {
  uint16_t i, j;
  EPD_SetRAMMP();
  EPD_SetRAMMA();
  EPD_WR_REG(0x24);
  for (i = 0; i < Gate_BITS; i++)
    for (j = 0; j < Source_BYTES; j++) EPD_WR_DATA8(0xFF);

  EPD_SetRAMMA();
  EPD_WR_REG(0x26);
  for (i = 0; i < Gate_BITS; i++)
    for (j = 0; j < Source_BYTES; j++) EPD_WR_DATA8(0x00);

  EPD_SetRAMSP();
  EPD_SetRAMSA();
  EPD_WR_REG(0xA4);
  for (i = 0; i < Gate_BITS; i++)
    for (j = 0; j < Source_BYTES; j++) EPD_WR_DATA8(0xFF);

  EPD_SetRAMSA();
  EPD_WR_REG(0xA6);
  for (i = 0; i < Gate_BITS; i++)
    for (j = 0; j < Source_BYTES; j++) EPD_WR_DATA8(0x00);
}

// Vuelca el framebuffer a la RAM de ambos controladores. El buffer esta
// organizado por filas, pero el SSD1683 espera columnas, de ahi el
// reordenamiento con templine/tempcol.
void EPD_Display(const uint8_t *ImageBW) {
  uint32_t i;
  uint8_t  tempOriginal;
  uint32_t tempcol  = 0;
  uint32_t templine = 0;

  EPD_SetRAMMP();
  EPD_SetRAMMA();
  EPD_WR_REG(0x24);
  for (i = 0; i < ALLSCREEN_BYTES; i++) {
    tempOriginal = *(ImageBW + templine * Source_BYTES * 2 + tempcol);
    templine++;
    if (templine >= Gate_BITS) { tempcol++; templine = 0; }
    EPD_WR_DATA8(tempOriginal);
  }

  EPD_SetRAMSP();
  EPD_SetRAMSA();
  EPD_WR_REG(0xa4);
  for (i = 0; i < ALLSCREEN_BYTES; i++) {
    tempOriginal = *(ImageBW + templine * Source_BYTES * 2 + tempcol);
    templine++;
    if (templine >= Gate_BITS) { tempcol++; templine = 0; }
    EPD_WR_DATA8(tempOriginal);
  }
}

/*===========================================================================
 *  SECCION 5 - PRIMITIVAS DE DIBUJO  (ex EPD.cpp)
 *=========================================================================*/

void Paint_NewImage(uint8_t *image, uint16_t Width, uint16_t Height,
                    uint16_t Rotate, uint16_t Color) {
  Paint.Image        = image;
  Paint.color        = Color;
  Paint.widthMemory  = Width;
  Paint.heightMemory = Height;
  Paint.widthByte    = (Width % 8 == 0) ? (Width / 8) : (Width / 8 + 1);
  Paint.heightByte   = Height;
  Paint.rotate       = Rotate;
  if (Rotate == 0 || Rotate == 180) {
    Paint.width  = Height;
    Paint.height = Width;
  } else {
    Paint.width  = Width;
    Paint.height = Height;
  }
}

void Paint_Clear(uint8_t Color) {
  for (uint16_t Y = 0; Y < Paint.heightByte; Y++)
    for (uint16_t X = 0; X < Paint.widthByte; X++)
      Paint.Image[X + Y * Paint.widthByte] = Color;
}

// Enciende un pixel. El +8 en Xpoint>=396 salta las columnas muertas de la
// union entre los dos SSD1683.
// OJO: X e Y son uint16_t. Con Rotation 180, un Ypoint >= 272 produce
// underflow (272-Ypoint-1) y una escritura MUY fuera del buffer.
void Paint_SetPixel(uint16_t Xpoint, uint16_t Ypoint, uint16_t Color) {
  uint16_t X, Y;
  uint32_t Addr;
  uint8_t  Rdata;

  switch (Paint.rotate) {
    case 0:
      if (Xpoint >= 396) Xpoint += 8;
      X = Xpoint;
      Y = Ypoint;
      break;
    case 90:
      if (Ypoint >= 396) Ypoint += 8;
      X = Paint.widthMemory - Ypoint - 1;
      Y = Xpoint;
      break;
    case 180:
      if (Xpoint >= 396) Xpoint += 8;
      X = Paint.widthMemory - Xpoint - 1;
      Y = Paint.heightMemory - Ypoint - 1;
      break;
    case 270:
      if (Ypoint >= 396) Ypoint += 8;
      X = Ypoint;
      Y = Paint.heightMemory - Xpoint - 1;
      break;
    default:
      return;
  }

  Addr  = X / 8 + Y * Paint.widthByte;
  Rdata = Paint.Image[Addr];
  if (Color == BLACK) Paint.Image[Addr] = Rdata & ~(0x80 >> (X % 8));
  else                Paint.Image[Addr] = Rdata |  (0x80 >> (X % 8));
}

// Bresenham
void EPD_DrawLine(uint16_t Xstart, uint16_t Ystart,
                  uint16_t Xend, uint16_t Yend, uint16_t Color) {
  uint16_t Xpoint = Xstart, Ypoint = Ystart;
  int dx = (int)Xend - (int)Xstart >= 0 ? Xend - Xstart : Xstart - Xend;
  int dy = (int)Yend - (int)Ystart <= 0 ? Yend - Ystart : Ystart - Yend;
  int XAddway = Xstart < Xend ? 1 : -1;
  int YAddway = Ystart < Yend ? 1 : -1;
  int Esp = dx + dy;

  for (;;) {
    Paint_SetPixel(Xpoint, Ypoint, Color);
    if (2 * Esp >= dy) {
      if (Xpoint == Xend) break;
      Esp += dy;
      Xpoint += XAddway;
    }
    if (2 * Esp <= dx) {
      if (Ypoint == Yend) break;
      Esp += dx;
      Ypoint += YAddway;
    }
  }
}

// mode: 0 = contorno, 1 = relleno
void EPD_DrawRectangle(uint16_t Xstart, uint16_t Ystart,
                       uint16_t Xend, uint16_t Yend,
                       uint16_t Color, uint8_t mode) {
  if (mode) {
    for (uint16_t i = Ystart; i < Yend; i++)
      EPD_DrawLine(Xstart, i, Xend, i, Color);
  } else {
    EPD_DrawLine(Xstart, Ystart, Xend,   Ystart, Color);
    EPD_DrawLine(Xstart, Ystart, Xstart, Yend,   Color);
    EPD_DrawLine(Xend,   Yend,   Xend,   Ystart, Color);
    EPD_DrawLine(Xend,   Yend,   Xstart, Yend,   Color);
  }
}

// Dibuja un caracter. Solo soporta size1 = 12, 16 y 24 (las tablas 8 y 48
// fueron podadas). El glifo pinta su propio fondo con !color, por lo que
// pasar WHITE sobre un area rellena de negro da texto en video inverso.
void EPD_ShowChar(uint16_t x, uint16_t y, uint16_t chr,
                  uint16_t size1, uint16_t color) {
  uint16_t i, m, temp, size2, chr1;
  uint16_t x0 = x, y0 = y;

  size2 = (size1 / 8 + ((size1 % 8) ? 1 : 0)) * (size1 / 2);
  chr1  = chr - ' ';

  for (i = 0; i < size2; i++) {
    if      (size1 == 12) temp = ascii_1206[chr1][i];
    else if (size1 == 16) temp = ascii_1608[chr1][i];
    else if (size1 == 24) temp = ascii_2412[chr1][i];
    else return;

    for (m = 0; m < 8; m++) {
      if (temp & 0x01) Paint_SetPixel(x, y, color);
      else             Paint_SetPixel(x, y, !color);
      temp >>= 1;
      y++;
    }
    x++;
    if ((size1 != 8) && ((x - x0) == size1 / 2)) { x = x0; y0 = y0 + 8; }
    y = y0;
  }
}

void EPD_ShowString(uint16_t x, uint16_t y, const char *chr,
                    uint16_t size1, uint16_t color) {
  while (*chr != '\0') {
    EPD_ShowChar(x, y, *chr, size1, color);
    chr++;
    x += size1 / 2;
  }
}

/*===========================================================================
 *  SECCION 6 - APLICACION
 *=========================================================================*/

// GPIO para reset WiFi
#define WIFI_RESET_PIN 1      // Boton EXIT del modulo 5.79 EPD
#define WIFI_RESET_TIME 3000  // 2 segundos

// Define a black and white image array as a buffer for e-paper display.
uint8_t ImageBW[27200];

// Configuración de NTP
WiFiUDP ntpUDP;
NTPClient timeClient(ntpUDP, "pool.ntp.org", -10800, 60000); // -10800 para GMT-3 (Argentina)

// Intervalo de actualización de la pantalla (24 horas en milisegundos)
const unsigned long DISPLAY_UPDATE_INTERVAL_MILLIS = 24 * 60 * 60 * 1000UL;

// Nombres estilo Casio: mes abreviado 3 letras, dia de semana 2 letras
const char* monthNames[] = {
  "JAN", "FEB", "MAR", "APR", "MAY", "JUN",
  "JUL", "AUG", "SEP", "OCT", "NOV", "DEC"
};
const char* dayOfWeekNames[] = {
  "SU", "MO", "TU", "WE", "TH", "FR", "SA"
};

// Prototipo: se usa en drawCalendarMonth, definida mas abajo
void EPD_ShowStringCentered(uint16_t cx, uint16_t y, const char *str,
                            uint16_t size1, uint16_t color);

// --- Funciones auxiliares ---
int daysInMonth(int month, int year) {
  if (month == 2) {
    if ((year % 4 == 0 && year % 100 != 0) || (year % 400 == 0)) {
      return 29;
    } else {
      return 28;
    }
  } else if (month == 4 || month == 6 || month == 9 || month == 11) {
    return 30;
  } else {
    return 31;
  }
}

// Función para verificar si se debe resetear WiFi
bool checkWiFiReset() {
  unsigned long pressStart = 0;
  bool wasPressed = false;
  
  if (digitalRead(WIFI_RESET_PIN) == LOW) {
    pressStart = millis();
    wasPressed = true;
    
    // Esperar a ver si se mantiene presionado
    while (digitalRead(WIFI_RESET_PIN) == LOW) {
      if (millis() - pressStart >= WIFI_RESET_TIME) {
        return true;  // Botón presionado por 2 segundos
      }
      delay(50);
    }
  }
  
  return false;
}

void setupWiFiManager() {
  WiFiManager wifiManager;
  
  // Timeout de 180 segundos para el portal de configuración
  wifiManager.setConfigPortalTimeout(180);
  
  // Personalizar el portal web con branding Electgpl
  wifiManager.setTitle("Electgpl Calendar");
  wifiManager.setHostname("electgpl-calendar");
  
  // Agregar información personalizada al portal web
  String customHTML = "<p style='text-align:center;font-size:18px;font-weight:bold;color:#0066cc;'>Electgpl</p>";
  customHTML += "<p style='text-align:center;'>EPD Calendar Configuration</p>";
  WiFiManagerParameter custom_text(customHTML.c_str());
  wifiManager.addParameter(&custom_text);
  
  // Mensaje personalizado
  wifiManager.setAPCallback([](WiFiManager *myWiFiManager) {
    Serial.println("Modo AP iniciado - Electgpl");
    Serial.print("Red WiFi: ");
    Serial.println(myWiFiManager->getConfigPortalSSID());
    Serial.println("IP: 192.168.4.1");
    
    // Mostrar mensaje en pantalla EPD
    Paint_Clear(WHITE);
    EPD_ShowString(250, 80, "Electgpl", 24, BLACK);
    EPD_ShowString(200, 110, "WiFi Config Mode", 16, BLACK);
    EPD_ShowString(200, 135, "Connect to WiFi:", 16, BLACK);
    String apName = myWiFiManager->getConfigPortalSSID();
    EPD_ShowString(220, 160, apName.c_str(), 16, BLACK);
    EPD_ShowString(230, 185, "IP: 192.168.4.1", 16, BLACK);
    EPD_Display(ImageBW);
    EPD_PartUpdate();
  });
  
  // Intentar conectar con credenciales guardadas
  // Si falla, inicia portal de configuración con nombre "Electgpl-Calendar"
  if (!wifiManager.autoConnect("Electgpl-Calendar")) {
    Serial.println("Fallo al conectar y timeout alcanzado");
    delay(3000);
    ESP.restart();
  }
  
  Serial.println("WiFi conectado exitosamente!");
  Serial.print("IP: ");
  Serial.println(WiFi.localIP());
}

void setup() {
  Serial.begin(115200);
  
  // Configurar GPIO de alimentación de pantalla
  pinMode(7, OUTPUT);
  digitalWrite(7, HIGH);
  
  // Configurar botón de reset WiFi con pull-up interno
  pinMode(WIFI_RESET_PIN, INPUT_PULLUP);
  
  // Inicializar pantalla EPD
  EPD_GPIOInit();
  Paint_NewImage(ImageBW, EPD_W, EPD_H, Rotation, WHITE);
  Paint_Clear(WHITE);
  
  EPD_FastMode1Init();
  EPD_Display_Clear();
  EPD_Update();
  EPD_Clear_R26A6H();
  
  // Verificar si se debe resetear WiFi
  if (checkWiFiReset()) {
    Serial.println("Reset WiFi solicitado!");
    
    // Mostrar mensaje en pantalla
    Paint_Clear(WHITE);
    EPD_ShowString(200, 120, "Resetting WiFi...", 24, BLACK);
    EPD_Display(ImageBW);
    EPD_PartUpdate();
    
    WiFiManager wifiManager;
    wifiManager.resetSettings();  // Borrar credenciales guardadas
    delay(1000);
    ESP.restart();
  }
  
  // Mostrar mensaje de conexión
  Paint_Clear(WHITE);
  EPD_ShowString(200, 120, "Connecting WiFi...", 24, BLACK);
  EPD_Display(ImageBW);
  EPD_PartUpdate();
  
  // Configurar WiFi con WiFiManager
  setupWiFiManager();
  
  // Inicializar cliente NTP
  timeClient.begin();
  
  // Sincronizar el reloj interno del ESP32 con NTP
  configTime(-10800, 0, "pool.ntp.org", "time.nist.gov");
  
  // Realizar la primera actualización de la pantalla
  updateDisplay();
  
  // Entrar en Deep Sleep después de la actualización
  Serial.printf("Entrando en Deep Sleep por %lu segundos...\n", DISPLAY_UPDATE_INTERVAL_MILLIS / 1000UL);
  ESP.deepSleep(DISPLAY_UPDATE_INTERVAL_MILLIS * 1000ULL);
}

void loop() {
  // Con Deep Sleep activado en setup(), este loop no se ejecutará.
  delay(10);
}

/*===========================================================================
 *                        PRIMITIVAS DE ESTILO CASIO
 *=========================================================================*/

// Muestra un string centrado horizontalmente respecto de cx.
// La fuente es de ancho fijo: size1/2 px por caracter.
void EPD_ShowStringCentered(uint16_t cx, uint16_t y, const char *str,
                            uint16_t size1, uint16_t color) {
  uint16_t w = strlen(str) * (size1 / 2);
  uint16_t x = (w / 2 <= cx) ? (cx - w / 2) : 0;
  EPD_ShowString(x, y, str, size1, color);
}

// Marco con esquinas recortadas y sombra desplazada, como el bisel de las
// pantallas LCD de las agendas Casio. La sombra son dos lineas paralelas
// corridas SHADOW px hacia abajo y hacia la derecha.
void EPD_DrawCasioFrame(int x0, int y0, int x1, int y1) {
  const int C = 4;         // recorte de esquina
  const int SHADOW = 2;    // desplazamiento de la sombra

  // Marco principal con esquinas recortadas
  EPD_DrawLine(x0 + C, y0, x1 - C, y0, BLACK);   // superior
  EPD_DrawLine(x0 + C, y1, x1 - C, y1, BLACK);   // inferior
  EPD_DrawLine(x0, y0 + C, x0, y1 - C, BLACK);   // izquierda
  EPD_DrawLine(x1, y0 + C, x1, y1 - C, BLACK);   // derecha

  // Diagonales de esquina
  EPD_DrawLine(x0, y0 + C, x0 + C, y0, BLACK);
  EPD_DrawLine(x1 - C, y0, x1, y0 + C, BLACK);
  EPD_DrawLine(x0, y1 - C, x0 + C, y1, BLACK);
  EPD_DrawLine(x1 - C, y1, x1, y1 - C, BLACK);

  // Sombra: solo borde inferior y derecho (fuente de luz arriba-izquierda)
  EPD_DrawLine(x0 + C + SHADOW, y1 + SHADOW, x1 - C + SHADOW, y1 + SHADOW, BLACK);
  EPD_DrawLine(x1 + SHADOW, y0 + C + SHADOW, x1 + SHADOW, y1 - C + SHADOW, BLACK);
}

// Punto separador de 2x2 px entre columnas de numeros. Es lo que da la
// textura de matriz de puntos caracteristica de estos displays.
void EPD_DrawDot(int x, int y) {
  Paint_SetPixel(x,     y,     BLACK);
  Paint_SetPixel(x + 1, y,     BLACK);
  Paint_SetPixel(x,     y + 1, BLACK);
  Paint_SetPixel(x + 1, y + 1, BLACK);
}

/*===========================================================================
 *                            DIBUJO DE UN MES
 *
 *  Layout verificado contra el presupuesto vertical (ver cabecera):
 *    marco        y =   4 .. 232   (+ sombra en 234)
 *    titulo f24   y =  12 ..  35
 *    dias f16     y =  44 ..  59
 *    linea        y =  62
 *    numeros f16  y =  68 .. 223   (6 filas de 28 px)
 *    inversion    y =  65 .. 226   (bloque de 22 px de alto)
 *=========================================================================*/
void drawCalendarMonth(int originX, int month, int year, int highlightDay = -1) {
  char buffer[16];

  const int CELL_W    = 32;
  const int CELL_H    = 28;
  const int GRID_W    = 7 * CELL_W;   // 224 px
  const int TITULO_Y  = 12;
  const int DOW_Y     = 44;
  const int LINEA_Y   = 62;
  const int DAYS_Y0   = 68;
  const int MARCO_Y0  = 4;
  const int MARCO_Y1  = 232;

  // Marco con sombra
  EPD_DrawCasioFrame(originX - 6, MARCO_Y0, originX + GRID_W + 2, MARCO_Y1);

  // Encabezado: "NOV 2026"
  sprintf(buffer, "%s %d", monthNames[month - 1], year);
  EPD_ShowStringCentered(originX + GRID_W / 2, TITULO_Y, buffer, 24, BLACK);

  // Dias de semana centrados en su celda
  for (int i = 0; i < 7; i++) {
    int cx = originX + (i * CELL_W) + CELL_W / 2;
    EPD_ShowStringCentered(cx, DOW_Y, dayOfWeekNames[i], 16, BLACK);
  }

  // Linea separadora bajo los nombres de dia
  EPD_DrawLine(originX + 2, LINEA_Y, originX + GRID_W - 2, LINEA_Y, BLACK);

  // Primer dia del mes
  struct tm firstDay = {0};
  firstDay.tm_year = year - 1900;
  firstDay.tm_mon  = month - 1;
  firstDay.tm_mday = 1;
  mktime(&firstDay);

  int firstWDay       = firstDay.tm_wday;
  int daysInThisMonth = daysInMonth(month, year);

  int dayCounter = 1;
  for (int week = 0; week < 6; week++) {
    for (int dow = 0; dow < 7; dow++) {
      if (week == 0 && dow < firstWDay) continue;
      if (dayCounter > daysInThisMonth) return;

      int cx = originX + (dow * CELL_W) + CELL_W / 2;
      int y  = DAYS_Y0 + (week * CELL_H);
      sprintf(buffer, "%d", dayCounter);

      // Fin de semana (SU y SA) en video inverso, como el Casio original
      bool esFinDeSemana = (dow == 0 || dow == 6);

      if (esFinDeSemana) {
        // Bloque relleno; la fuente pinta su propio fondo con !color, asi
        // que WHITE sobre el relleno negro da digito blanco sobre negro.
        EPD_DrawRectangle(cx - 13, y - 3, cx + 13, y + 19, BLACK, 1);
        EPD_ShowStringCentered(cx, y, buffer, 16, WHITE);
      } else {
        EPD_ShowStringCentered(cx, y, buffer, 16, BLACK);
      }

      // Dia de hoy: marco hueco alrededor de la celda. Se distingue tanto
      // sobre fondo blanco como sobre un bloque de fin de semana invertido.
      if (dayCounter == highlightDay) {
        EPD_DrawRectangle(cx - 15, y - 5, cx + 15, y + 21, BLACK, 0);
      }

      // Punto separador hacia la columna siguiente
      if (dow < 6) {
        EPD_DrawDot(originX + (dow + 1) * CELL_W - 1, y + 11);
      }

      dayCounter++;
    }
  }
}

/*===========================================================================
 *  Linea de estado al pie, en el espiritu de los "C246/120 363" del Casio:
 *  dia del año, dias restantes, numero de semana ISO y fecha de refresco.
 *=========================================================================*/
void drawCasioStatusLine(struct tm &timeinfo) {
  const int STATUS_Y = 250;

  int diaDelAnio  = timeinfo.tm_yday + 1;
  int totalDias   = daysInMonth(2, timeinfo.tm_year + 1900) == 29 ? 366 : 365;
  int restantes   = totalDias - diaDelAnio;
  int semana      = (diaDelAnio + 6) / 7;
  int totalSemanas = (totalDias + 6) / 7;   // 53: la ultima queda parcial

  // Cada grupo se lee "actual / total":
  //   D222/365 -> dia 222 de 365     R143 -> dias Restantes
  //   W32/53   -> semana 32 de 53    (semana corrida, no ISO-8601)
  char linea[80];
  snprintf(linea, sizeof(linea), "D%03d/%03d  R%03d  W%02d/%02d",
           diaDelAnio, totalDias, restantes, semana, totalSemanas);
  EPD_ShowString(20, STATUS_Y, linea, 12, BLACK);

  char upd[40];
  strftime(upd, sizeof(upd), "UPD %d/%m/%Y %H:%M", &timeinfo);
  // Alineado a la derecha: fuente 12 -> 6 px por caracter
  int x = 760 - (int)strlen(upd) * 6;
  EPD_ShowString(x, STATUS_Y, upd, 12, BLACK);
}

/*===========================================================================
 *                          ACTUALIZACION DE PANTALLA
 *=========================================================================*/
void updateDisplay() {
  Paint_Clear(WHITE);

  struct tm timeinfo;
  if (!getLocalTime(&timeinfo)) {
    Serial.println("Fallo al obtener la hora del servidor NTP.");
    EPD_ShowString(10, 10, "Error de hora!", 16, BLACK);
    EPD_ShowString(10, 30, "Revisa WiFi/NTP", 16, BLACK);
    EPD_Display(ImageBW);
    EPD_PartUpdate();
    return;
  }

  int day   = timeinfo.tm_mday;
  int month = timeinfo.tm_mon + 1;
  int year  = timeinfo.tm_year + 1900;

  int nextMonth1 = month + 1;
  int nextMonth2 = month + 2;
  int year1 = year;
  int year2 = year;

  if (nextMonth1 > 12) { nextMonth1 -= 12; year1++; }
  if (nextMonth2 > 12) { nextMonth2 -= 12; year2 += (nextMonth1 == 12 ? 1 : 0); }

  // Origenes horizontales verificados: marcos en 14..246, 270..502, 526..758
  // (+2 px de sombra), con 24 px de separacion entre columnas.
  drawCalendarMonth( 20, month,      year,  day);
  drawCalendarMonth(276, nextMonth1, year1, -1);
  drawCalendarMonth(532, nextMonth2, year2, -1);

  drawCasioStatusLine(timeinfo);

  EPD_Display(ImageBW);
  EPD_PartUpdate();
}
